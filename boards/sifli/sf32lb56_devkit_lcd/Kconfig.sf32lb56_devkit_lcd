## boards/sifli/sf32lb56_devkit_lcd/Kconfig.sf32lb56_devkit_lcd
```kconfig
# Copyright (c) 2026 Hraph
# SPDX-License-Identifier: Apache-2.0

config BOARD_SF32LB56_DEVKIT_LCD
	bool
	select SOC_SF32LB56X
```

## boards/sifli/sf32lb56_devkit_lcd/board.yml
```yaml
# Copyright (c) 2026 Hraph
# SPDX-License-Identifier: Apache-2.0

board:
  name: sf32lb56_devkit_lcd
  full_name: SF32LB56-LCD DevKit with N16R12N1
  vendor: sifli
  socs:
    - name: sf32lb56x
```

## boards/sifli/sf32lb56_devkit_lcd/sf32lb56_devkit_lcd_defconfig
```kconfig
# Copyright (c) 2026 Hraph
# SPDX-License-Identifier: Apache-2.0

CONFIG_ARM_MPU=y
CONFIG_HW_STACK_PROTECTION=y

CONFIG_DYNAMIC_INTERRUPTS=y

CONFIG_SERIAL=y
CONFIG_GPIO=y

CONFIG_CONSOLE=y
CONFIG_UART_CONSOLE=y
```

## drivers/pinctrl/Kconfig.sf32lb56x
```kconfig
# Copyright (c) 2025 Core Devices LLC
# SPDX-License-Identifier: Apache-2.0

config PINCTRL_SF32LB56X
	bool "Pin controller driver for SiFli SF32LB56X series"
	default y
	depends on DT_HAS_SIFLI_SF32LB56X_PINMUX_ENABLED
	help
	  Enable pin controller driver for SiFli SF32LB56X series.
	  Supports HPSYS SA/PA pins and LPSYS PB pins.
```

## dts/bindings/pinctrl/sifli,sf32lb56x-pinmux.yaml
```yaml
# Copyright (c) 2025 Core Devices LLC
# Copyright (c) 2025 SiFli Technologies(Nanjing) Co., Ltd
# SPDX-License-Identifier: Apache-2.0

description: |
    SF32LB56x Pin multiplexer and pin configuration controller.

    Covers HPSYS_PINMUX (SA and PA pins) and LPSYS_PINMUX (PB pins).
    Three reg entries are required: pad_sa, pad_pa, pad_pb.

    See sifli,sf32lb52x-pinmux.yaml for general usage. PB pins support
    FSEL, PE, PS and IE configuration; drive-strength is not available
    on LPSYS PB pins.

compatible: "sifli,sf32lb56x-pinmux"

include: [base.yaml, sifli-sf32lb-cfg.yaml]

properties:
  reg:
    required: true

  reg-names:
    required: true

  clocks:
    required: true

  sifli,cfg:
    required: true

  "#sifli,pinmux-cells":
    type: int
    const: 2

sifli,pinmux-cells:
  - port
  - offset

child-binding:
  child-binding:
    include:
      - name: pincfg-node.yaml
        property-allowlist:
          - bias-pull-down
          - bias-pull-up
          - input-enable
          - input-schmitt-enable
          - slew-rate
          - drive-strength

    properties:
      pinmux:
        required: true
        type: array
        description: |
          An array of pins sharing the same group properties. The pins should
          be defined using pre-defined macros or, alternatively, using the
          SF32LB_PINMUX utility macro.

      slew-rate:
        default: 0
        enum:
          - 0
          - 1

      drive-strength:
        default: 4
        enum:
          - 2
          - 8
          - 4
          - 12
          - 20
```

## soc/sifli/sf32/sf32lb56x/Kconfig
```kconfig
# Copyright (c) 2025 Core Devices LLC
# Copyright (c) 2026 Hraph
# SPDX-License-Identifier: Apache-2.0

config SOC_SERIES_SF32LB56X
	select ARM
	select CPU_CORTEX_M33
	select CPU_HAS_ARM_MPU
	select CPU_HAS_FPU
	select ARMV8_M_DSP
	select CPU_HAS_ICACHE
	select CPU_HAS_DCACHE
	select SOC_EARLY_INIT_HOOK

if SOC_SERIES_SF32LB56X

config SF32LB56X_BOOTROM_FLASH_ON_DELAY_MS
	int "Boot ROM flash on delay (ms)"
	default 0
	range 0 4095

config SF32LB56X_BOOTROM_FLASH_OFF_DELAY_MS
	int "Boot ROM flash off delay (ms)"
	default 0
	range 0 255

endif # SOC_SERIES_SF32LB56X
```

## soc/sifli/sf32/sf32lb56x/Kconfig.soc
```kconfig
# Copyright (c) 2025 Core Devices LLC
# Copyright (c) 2026 Hraph
# SPDX-License-Identifier: Apache-2.0

config SOC_SERIES_SF32LB56X
	bool
	select SOC_FAMILY_SF32

config SOC_SERIES
	default "sf32lb56x" if SOC_SERIES_SF32LB56X

config SOC_SF32LB56X
	bool
	select SOC_SERIES_SF32LB56X
	select CPU_HAS_ARM_MPU

config SOC
	default "sf32lb56x" if SOC_SF32LB56X
```
